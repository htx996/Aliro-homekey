## components/app_config/Kconfig
```kconfig
menu "Aliro configuration defaults"

comment "Applied on first boot and after a config reset. Edit at runtime in the web UI."

config ALIRO_DEFAULT_DEVICE_NAME
    string "Device name"
    default "aliro-homekey"

config ALIRO_READER_GROUP_ID
    string "Reader group identifier (32 hex chars)"
    default "00112233445566778899AABBCCDDEEFF"
    help
        16-byte Reader Group Identifier. Identifies this installation to user
        devices; every reader in the same lock group shares it. Change it
        before deploying anything real.

menu "NFC frontend"

# Per target, because the ESP32 defaults are not merely a poor fit elsewhere:
# GPIO 23 does not exist on the C3 at all, so a C3 image carrying them would
# build, boot, and then fail to bring up the reader with nothing in the log to
# say the pin was imaginary. The C3 numbers below avoid its flash pins (12-17)
# and its strapping pins (2, 8, 9); the C6 and H2 avoid theirs.

config ALIRO_NFC_SPI_SCK
    int "SPI SCK"
    default 4 if IDF_TARGET_ESP32C3
    default 6 if IDF_TARGET_ESP32C6 || IDF_TARGET_ESP32H2
    default 18

config ALIRO_NFC_SPI_MISO
    int "SPI MISO"
    default 5 if IDF_TARGET_ESP32C3
    default 7 if IDF_TARGET_ESP32C6 || IDF_TARGET_ESP32H2
    default 19

config ALIRO_NFC_SPI_MOSI
    int "SPI MOSI"
    default 6 if IDF_TARGET_ESP32C3
    default 10 if IDF_TARGET_ESP32C6 || IDF_TARGET_ESP32H2
    default 23

config ALIRO_NFC_SPI_CS
    int "SPI CS"
    default 7 if IDF_TARGET_ESP32C3
    default 11 if IDF_TARGET_ESP32C6 || IDF_TARGET_ESP32H2
    default 5

config ALIRO_NFC_ECP_BEACON
    bool "Emit the Apple ECP beacon during NFC polling"
    default y
    help
        Broadcasts an 18-byte Apple ECP frame naming this reader and the Aliro
        profile, which is what lets a locked phone offer its credential without
        the wallet being opened -- Express Mode. Without it a tap needs the key
        picked in Wallet first.

        The PN532 sends it after an empty Type-A poll, using that poll to set up
        the radio and resetting CIU_BitFraming to eight bits before the raw ECP
        frame.

        On by default. This has been off and on before, so the history matters:

        PR #3 ("restore Apple Wallet Express Mode polling") turned it on, and
        v0.5 shipped that way. A board on that build then hit a bus desync on
        first boot:

            E nfc/pn532: broadcast_ecp(581): ECP transmission failed
            E nfc/pn532: pn532_command(345): 0x4A: no ACK   [repeats forever]

        The InCommunicateThru call for the beacon does not get its response
        inside the timeout. At the time nothing ever retried the init sequence,
        so every InListPassiveTarget after it failed the same way until the
        chip was power-cycled -- a reader that cannot read any card at all,
        which is worse than the problem the beacon solves. That is why v0.6
        defaulted it back off.

        Turning it off also took Express Mode with it, which is issue #13:
        v0.5 tapped fine from a locked phone, v0.6 does not. Meanwhile the
        recovery path added for issue #12 landed in that same release --
        pn532_activate() now re-runs the init sequence after 20 consecutive
        comms failures, roughly two seconds. That changes what a desync costs:
        no longer dead until reboot, just a short gap before the reader comes
        back on its own.

        A desync that self-heals in about two seconds is a better trade than
        never offering Express Mode at all, so this is on again. The underlying
        desync is still not root-caused -- that needs a logic analyzer on the
        SPI/I2C lines. Turn this off if a reader still spends more time
        recovering than reading.

config ALIRO_NFC_IRQ
    int "IRQ pin (-1 if unused)"
    default -1

config ALIRO_NFC_RST
    int "Reset / VEN pin (-1 if unused)"
    default -1

endmenu

menu "Lock output"

config ALIRO_LOCK_GPIO
    int "Lock output GPIO"
    default 2
    help
        GPIO driving the relay, strike or lock driver. On a bare DevKit this
        can stay on the on-board LED pin for bring-up.

config ALIRO_LOCK_ACTIVE_LOW
    bool "Lock output is active low"
    default n
    help
        Most relay boards for the ESP32 are active low.

config ALIRO_LOCK_UNLOCK_MS
    int "Unlock duration (ms)"
    default 3000

endmenu

menu "Feedback outputs"

config ALIRO_FEEDBACK_LED_GPIO
    int "Status LED GPIO (-1 if unused)"
    default -1
    help
        Mirrors the current lock state. Off by default -- set a pin and
        enable it from the web UI's Feedback page, no rebuild required.

config ALIRO_FEEDBACK_LED_DENIED_GPIO
    int "Denied LED GPIO (-1 if unused)"
    default -1
    help
        A second LED, pulsed for a configurable time when a tap is refused.

        The status LED above tracks lock state, so it says nothing at all
        about a tap that was rejected -- it just stays off, exactly as it
        does when nobody has tapped. The buzzer already distinguishes the
        two cases with separate granted and denied tunes; this gives the
        same distinction to installations that want a red LED instead of
        noise. Requested in issue #13.

config ALIRO_FEEDBACK_BUZZER_GPIO
    int "Buzzer GPIO (-1 if unused)"
    default -1
    help
        Drives a piezo buzzer via LEDC, playing a configurable RTTTL tune on
        a granted or denied tap. Off by default; enable and set tunes from
        the web UI.

endmenu

menu "Network"

config ALIRO_AP_PASSWORD
    string "Setup access point password (>= 8 chars)"
    default "aliro1234"
    help
        The device starts this access point when it has no Wi-Fi credentials
        or cannot join. Connect to it to reach the configuration UI.

endmenu

config ALIRO_MAX_CREDENTIALS
    int "Maximum registered credentials"
    default 8
    help
        Foundation-phase credential store: a fixed in-memory table, populated
        at boot. Persistent storage and enrollment replace it later.

if ALIRO_MATTER_ENABLE

menu "Matter capacity"

comment "How many people and HomeKeys this build supports. Fixed at build time --"
comment "these size static arrays and a Matter attribute a phone reads once and"
comment "expects to stay true, so there is no live web UI equivalent of this menu."

config ALIRO_MAX_USERS
    int "Maximum Matter Users"
    range 5 250
    default 5
    help
        One Matter "User" per person who can be individually named and
        revoked -- this is what lets an admin remove one member without
        touching anyone else's access. The Matter minimum is 5; the Aliro
        specification example ships the same number, which is enough for one
        household but not an organisation.

        Cost is static RAM only, allocated once at boot regardless of how
        many people are actually enrolled: roughly 50 bytes per user, so even
        50 users is under 3 KB. This does not touch the runtime RAM that
        commissioning and fabric subscriptions compete for -- see
        ALIRO_MAX_ALIRO_KEYS and issue #13 for what does.

        Raise this to your real membership count, not a guess at future
        growth: NumberOfTotalUsersSupported is reported to every controller
        as a fixed attribute, so shrinking it later without factory-resetting
        the fabric can leave a phone's own bookkeeping out of step with what
        the lock will actually accept.

config ALIRO_MAX_ALIRO_KEYS
    int "Maximum Aliro HomeKeys"
    range 8 500
    default 8
    help
        How many distinct phones can hold a HomeKey to this reader, evictable
        and non-evictable combined -- this is the number that actually
        matters for "how many people can tap in." Espressif's own reference
        reader ships 8.

        Cost is static RAM: roughly 70 bytes per slot (an uncompressed P-256
        point plus bookkeeping), so 48 slots is under 3.5 KB. Storage is not
        what has caused failures on this project -- NVS has room for
        hundreds of these. What has failed is runtime RAM during
        commissioning and fabric reconnection, which this number does not
        add to: a stored-but-unused key slot costs nothing beyond the bytes
        above, because unlike a fabric it never opens a session of its own.

        Matter reports this number to every controller
        (NumberOfAliroEndpointKeysSupported), so raise it to real headcount
        rather than shrinking it later.

endmenu

endif # ALIRO_MATTER_ENABLE

endmenu
```
